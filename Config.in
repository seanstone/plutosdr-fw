## Config.in
```kconfig
source "../package/device-tree-xlnx/Config.in.host"
source "../package/hdl/Config.in"
source "../package/uboot-env/Config.in"
```

## configs/zynq_pluto_defconfig
```kconfig
BR2_arm=y
BR2_cortex_a9=y
BR2_ARM_ENABLE_NEON=y
BR2_ARM_ENABLE_VFP=y
BR2_ARM_FPU_NEON=y
BR2_KERNEL_HEADERS_5_15=y
BR2_BINUTILS_VERSION_2_39_X=y
BR2_GCC_VERSION_12_X=y
BR2_TOOLCHAIN_BUILDROOT_CXX=y
BR2_HOST_DIR=" $(BR2_EXTERNAL)/build/host"
BR2_CCACHE=y
BR2_OPTIMIZE_2=y
BR2_TARGET_GENERIC_HOSTNAME="pluto"
BR2_TARGET_GENERIC_ISSUE="Welcome to Pluto"
BR2_ROOTFS_DEVICE_CREATION_DYNAMIC_MDEV=y
BR2_ROOTFS_MERGED_USR=y
BR2_TARGET_GENERIC_ROOT_PASSWD="analog"
BR2_TARGET_GENERIC_GETTY_PORT="ttyPS0"
BR2_SYSTEM_DEFAULT_PATH="/bin:/sbin:/usr/bin:/usr/sbin"
BR2_ROOTFS_OVERLAY="$(BR2_EXTERNAL)/board/pluto/rootfs_overlay/"
BR2_ROOTFS_POST_BUILD_SCRIPT="$(BR2_EXTERNAL)/board/pluto/post-build.sh"
BR2_ROOTFS_POST_IMAGE_SCRIPT="$(BR2_EXTERNAL)/board/pluto/post-image.sh"
BR2_LINUX_KERNEL=y
BR2_LINUX_KERNEL_CUSTOM_GIT=y
BR2_LINUX_KERNEL_CUSTOM_REPO_URL="https://github.com/analogdevicesinc/linux"
BR2_LINUX_KERNEL_CUSTOM_REPO_VERSION="e14e35153"
BR2_LINUX_KERNEL_DEFCONFIG="zynq_pluto"
BR2_LINUX_KERNEL_CONFIG_FRAGMENT_FILES="$(BR2_EXTERNAL)/board/pluto/linux-extras.config"
BR2_LINUX_KERNEL_ZSTD=y
BR2_PACKAGE_BUSYBOX_CONFIG="$(BR2_EXTERNAL)/board/pluto/busybox-1.25.0.config"
BR2_PACKAGE_BUSYBOX_CONFIG_FRAGMENT_FILES="$(BR2_EXTERNAL)/board/pluto/busybox-extras.config"
BR2_PACKAGE_ZSTD=y
BR2_PACKAGE_MTD=y
# BR2_PACKAGE_MTD_NANDDUMP is not set
# BR2_PACKAGE_MTD_NANDTEST is not set
# BR2_PACKAGE_MTD_NANDWRITE is not set
# BR2_PACKAGE_MTD_UBIATTACH is not set
# BR2_PACKAGE_MTD_UBICRC32 is not set
# BR2_PACKAGE_MTD_UBIDETACH is not set
# BR2_PACKAGE_MTD_UBIFORMAT is not set
# BR2_PACKAGE_MTD_UBIMKVOL is not set
# BR2_PACKAGE_MTD_UBINFO is not set
# BR2_PACKAGE_MTD_UBINIZE is not set
# BR2_PACKAGE_MTD_UBIRENAME is not set
# BR2_PACKAGE_MTD_UBIRMVOL is not set
# BR2_PACKAGE_MTD_UBIRSVOL is not set
# BR2_PACKAGE_MTD_UBIUPDATEVOL is not set
# BR2_PACKAGE_MTD_UBIBLOCK is not set
BR2_PACKAGE_LINUX_FIRMWARE=y
BR2_PACKAGE_INPUT_EVENT_DAEMON=y
BR2_PACKAGE_UBOOT_TOOLS=y
BR2_PACKAGE_LIBAD9361_IIO=y
BR2_PACKAGE_LIBGPIOD=y
BR2_PACKAGE_LIBGPIOD_TOOLS=y
BR2_PACKAGE_LIBIIO_IIOD_USBD=y
BR2_PACKAGE_LIBIIO_TESTS=y
BR2_PACKAGE_LIBINI=y
BR2_PACKAGE_LIBNL=y
BR2_PACKAGE_AVAHI=y
BR2_PACKAGE_AVAHI_DAEMON=y
BR2_PACKAGE_AVAHI_LIBDNSSD_COMPATIBILITY=y
BR2_PACKAGE_DROPBEAR=y
BR2_PACKAGE_DROPBEAR_DISABLE_REVERSEDNS=y
BR2_PACKAGE_DROPBEAR_LOCALOPTIONS_FILE="$(BR2_EXTERNAL)/board/pluto/dropbear/localoptions.h"
BR2_PACKAGE_RSYNC=y
BR2_PACKAGE_HTOP=y
BR2_PACKAGE_NANO=y
BR2_PACKAGE_POLL_SYSFS=y
BR2_PACKAGE_AD936X_REF_CAL=y
BR2_TARGET_ROOTFS_CPIO=y
BR2_TARGET_ROOTFS_CPIO_GZIP=y
# BR2_TARGET_ROOTFS_TAR is not set
BR2_TARGET_UBOOT=y
BR2_TARGET_UBOOT_BUILD_SYSTEM_KCONFIG=y
BR2_TARGET_UBOOT_CUSTOM_GIT=y
BR2_TARGET_UBOOT_CUSTOM_REPO_URL="https://github.com/analogdevicesinc/u-boot-xlnx.git"
BR2_TARGET_UBOOT_CUSTOM_REPO_VERSION="90401ce"
BR2_TARGET_UBOOT_BOARD_DEFCONFIG="zynq_pluto"
# BR2_TARGET_UBOOT_FORMAT_BIN is not set
BR2_TARGET_UBOOT_FORMAT_ELF=y
BR2_PACKAGE_HOST_DOSFSTOOLS=y
BR2_PACKAGE_HOST_GENIMAGE=y
BR2_PACKAGE_HOST_MTOOLS=y
BR2_PACKAGE_HOST_UBOOT_TOOLS=y
BR2_PACKAGE_HDL=y
BR2_PACKAGE_UBOOT_ENV=y
```

## package/hdl/Config.in
```kconfig
config BR2_PACKAGE_HDL
	bool "hdl"
  select BR2_PACKAGE_HOST_DEVICE_TREE_XLNX
	select BR2_PACKAGE_UBOOT
	help
	  Analog Devices HDL libraries and projects

config HDL_VIVADO_PATH
    string "Path to Vivado"
    default "/tools/Xilinx/Vivado/2023.2"
    help
      Path to Vivado

config HDL_VITIS_PATH
    string "Path to Vivado"
    default "/tools/Xilinx/Vitis/2023.2"
    help
      Path to Vitis

config HDL_PROJECTS
    string "HDL projects"
    default "pluto"
    help
      List of HDL projects
```

## package/uboot-env/Config.in
```kconfig
config BR2_PACKAGE_UBOOT_ENV
	bool "uboot-env"
	select BR2_PACKAGE_UBOOT
	help
	  uboot-env
```
